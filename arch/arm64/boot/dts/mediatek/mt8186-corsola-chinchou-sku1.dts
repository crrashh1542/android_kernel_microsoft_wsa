// SPDX-License-Identifier: (GPL-2.0 OR MIT)
/*
 * Copyright 2023 Google LLC
 */

/dts-v1/;
#include "mt8186-corsola-chinchou.dtsi"

/ {
	model = "Google chinchou sku1/sku17 board";
	compatible = "google,chinchou-sku1", "google,chinchou-sku17",
			"mediatek,mt8186";
};

&i2c1 {
	i2c-scl-internal-delay-ns = <10000>;

	touchscreen: touchscreen@41 {
		compatible = "hid-over-i2c";
		reg = <0x41>;
		interrupts-extended = <&pio 12 IRQ_TYPE_LEVEL_LOW>;
		pinctrl-names = "default";
		pinctrl-0 = <&touchscreen_pins>;
		post-power-on-delay-ms = <10>;
		hid-descr-addr = <0x0001>;
		vdd-supply = <&pp3300_s3>;
	};
};

&gpio_keys {
	status = "disabled";
};
