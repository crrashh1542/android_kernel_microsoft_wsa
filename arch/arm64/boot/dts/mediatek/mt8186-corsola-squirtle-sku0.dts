// SPDX-License-Identifier: (GPL-2.0 OR MIT)
/*
 * Copyright 2024 Google LLC
 */

/dts-v1/;
#include "mt8186-corsola-squirtle.dtsi"

/ {
	model = "Google squirtle sku0/unprovisioned board";
	compatible = "google,squirtle-sku0","google,squirtle-sku2147483647",
		     "google,squirtle","mediatek,mt8186";
};
