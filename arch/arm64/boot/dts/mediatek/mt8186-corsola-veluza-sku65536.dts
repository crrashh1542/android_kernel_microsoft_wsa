// SPDX-License-Identifier: (GPL-2.0 OR MIT)
/*
 * Copyright 2024 Google LLC
 */

/dts-v1/;
#include "mt8186-corsola-veluza.dtsi"

/ {
	model = "Google veluza sku65536/65537 board";
	compatible = "google,veluza-sku65536", "google,veluza-sku65537",
		     "google,veluza", "google,corsola", "mediatek,mt8186";
};

&i2c1 {
	/delete-node/ touchscreen@10;
	touchscreen@10 {
		compatible = "elan,ekth3500";
		reg = <0x10>;
		interrupts-extended = <&pio 12 IRQ_TYPE_LEVEL_LOW>;
		status = "okay";
	};
};

&gpio_keys {
	status = "disabled";
};
