// SPDX-License-Identifier: (GPL-2.0 OR MIT)
/*
 * Copyright 2023 Google LLC
 */

/dts-v1/;
#include "mt8186-corsola-ponyta.dtsi"

/ {
	model = "Google Ponyta sku0/unprovisioned board";
	compatible = "google,ponyta-sku0", "google,ponyta-sku2147483647",
		     "google,ponyta", "mediatek,mt8186";
};

&i2c2 {
	touchpad@2c {
		compatible = "hid-over-i2c";
		reg = <0x2c>;
		hid-descr-addr = <0x20>;
		interrupts-extended = <&pio 11 IRQ_TYPE_LEVEL_LOW>;
		vcc-supply = <&pp3300_s3>;
		wakeup-source;
	};
};
