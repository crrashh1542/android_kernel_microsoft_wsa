// SPDX-License-Identifier: (GPL-2.0 OR MIT)
/*
 * Copyright 2023 Google LLC
 */

/dts-v1/;
#include "mt8186-corsola-ponyta.dtsi"

/ {
	model = "Google Ponyta sku1 board";
	compatible = "google,ponyta-sku1", "google,ponyta", "mediatek,mt8186";
};

&i2c2 {
	touchpad@15 {
		compatible = "elan,ekth3000";
		reg = <0x15>;
		interrupt-parent = <&pio>;
		interrupts = <11 IRQ_TYPE_LEVEL_LOW>;
		vcc-supply = <&pp3300_s3>;
		wakeup-source;
	};
};

&usb_c1 {
	status = "disabled";
};
