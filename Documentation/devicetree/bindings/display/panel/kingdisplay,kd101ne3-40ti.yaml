## Documentation/devicetree/bindings/display/panel/kingdisplay,kd101ne3-40ti.yaml
```yaml
# SPDX-License-Identifier: (GPL-2.0-only OR BSD-2-Clause)
%YAML 1.2
---
$id: http://devicetree.org/schemas/display/panel/kingdisplay,kd101ne3-40ti.yaml#
$schema: http://devicetree.org/meta-schemas/core.yaml#

title: King Display KD035G6-40TI based MIPI-DSI panels

description: |
  -This binding is for display panels using an JD9365DA controller

maintainers:
  - Zhaoxiong Lv <lvzhaoxiong@huaqin.corp-partner.google.com>

allOf:
  - $ref: panel-common.yaml#

properties:
  compatible:
    const: kingdisplay,kd101ne3-40ti

  backlight: true
  port: true
  pp3300-supply: true
  reg: true
  enable-gpios: true
  rotation: true

required:
  - compatible
  - reg
  - enable-gpios
  - pp3300-supply
  - backlight
  - port

unevaluatedProperties: false

examples:
  - |
    #include <dt-bindings/gpio/gpio.h>

    dsi {
        #address-cells = <1>;
        #size-cells = <0>;
        panel: panel@0 {
            compatible = "kingdisplay,kd101ne3-40ti";
            reg = <0>;
            enable-gpios = <&pio 98 0>;
            pinctrl-names = "default";
            pinctrl-0 = <&panel_pins_default>;
            pp3300-supply = <&en_pp6000_mipi_disp>;
            backlight = <&backlight_lcd0>;
            rotation = <90>;
            port {
                panel_in: endpoint {
                    remote-endpoint = <&dsi_out>;
                };
            };
        };
    };

...
```

## Documentation/devicetree/bindings/display/panel/starry,er88577.yaml
```yaml
# SPDX-License-Identifier: (GPL-2.0-only OR BSD-2-Clause)
%YAML 1.2
---
$id: http://devicetree.org/schemas/display/panel/starry,er88577.yaml#
$schema: http://devicetree.org/meta-schemas/core.yaml#

title: Starry Display ER88577 based MIPI-DSI panels

description:
  -Add a display panel for the ER88577 controller

maintainers:
  - Zhaoxiong Lv <lvzhaoxiong@huaqin.corp-partner.google.com>

allOf:
  - $ref: panel-common.yaml#

properties:
  compatible:
    const: starry,er88577

  pp3300-supply: true
  reg: true
  enable-gpios: true
  backlight: true
  port: true
  rotation: true

required:
  - compatible
  - pp3300-supply
  - reg
  - enable-gpios
  - backlight
  - port

unevaluatedProperties: false

examples:
  - |
    dsi {
        #address-cells = <1>;
        #size-cells = <0>;
        panel: panel@0 {
            compatible = "starry,er88577";
            reg = <0>;
            enable-gpios = <&pio 98 0>;
            pinctrl-names = "default";
            pinctrl-0 = <&panel_pins_default>;
            pp3300-supply = <&en_pp6000_mipi_disp>;
            backlight = <&backlight_lcd0>;
            rotation = <90>;
            port {
                panel_in: endpoint {
                    remote-endpoint = <&dsi_out>;
                };
            };
        };
    };

...
```

## Documentation/devicetree/bindings/iio/proximity/tyhx,hx9031as.yaml
```yaml
# SPDX-License-Identifier: (GPL-2.0-only OR BSD-2-Clause)
%YAML 1.2
---
$id: http://devicetree.org/schemas/iio/proximity/tyhx,hx9031as.yaml#
$schema: http://devicetree.org/meta-schemas/core.yaml#

title: Tyhx HX9031AS capacitive proximity SAR sensor

maintainers:
  - Yasin Lee <yasin.lee.x@gmail.com>

description: |
  Tyhx's HX9031AS proximity sensor.

allOf:
  - $ref: /schemas/iio/iio.yaml#

properties:
  compatible:
    const: tyhx,hx9031as

  reg:
    maxItems: 1

  interrupts:
    description:
      Generated by device to announce preceding read request has finished
      and data is available or that a close/far proximity event has happened.
    maxItems: 1

  vdd-supply:
    description: Main power supply

required:
  - compatible
  - reg

unevaluatedProperties: false

examples:
  - |
    #include <dt-bindings/interrupt-controller/irq.h>
    i2c {
      #address-cells = <1>;
      #size-cells = <0>;
      hx9031as@2a {
        compatible = "tyhx,hx9031as";
        reg = <0x2a>;
        interrupt-parent = <&pio>;
        interrupts = <16 IRQ_TYPE_EDGE_FALLING 16 0>;
        vdd-supply = <&pp3300_a>;
        status = "okay";
      };
    };
```
